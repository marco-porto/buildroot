## package/aasdk/Config.in
```kconfig
config BR2_PACKAGE_AASDK
	bool "aasdk"
	select BR2_PACKAGE_LIBUSB
	select BR2_PACKAGE_OPENSSL
	select BR2_PACKAGE_BOOST
	select BR2_PACKAGE_PROTOBUF
	help
	  AASDK is an implementation of the Android Auto protocol.

	  https://github.com/marco-porto/aasdk
```

## package/openauto/Config.in
```kconfig
config BR2_PACKAGE_OPENAUTO
    bool "openauto"
    help
      OpenAuto is an Android Auto head unit emulator.

      https://github.com/marco-porto/openauto
```

## package/rtaudio/Config.in
```kconfig
config BR2_PACKAGE_RTAUDIO
    bool "rtaudio"
    select BR2_PACKAGE_ALSA_LIB
    select BR2_PACKAGE_JACK2
    help
      RtAudio is a set of C++ classes that provide a common API for realtime
      audio input/output across different operating systems.

      https://www.music.mcgill.ca/~gary/rtaudio/
```
